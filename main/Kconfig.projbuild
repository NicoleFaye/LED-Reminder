## main/Kconfig.projbuild
```kconfig
menu "USB Dev MSC Example Configuration"

    choice EXAMPLE_STORAGE_MEDIA
        prompt "Storage Media Used"
        default EXAMPLE_STORAGE_MEDIA_SPIFLASH
        help
            Select the storage media that is exposed to USB host.

        config EXAMPLE_STORAGE_MEDIA_SPIFLASH
            bool "SPI FLASH"

    endchoice

endmenu
```
